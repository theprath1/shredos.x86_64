## package/libfprint/Config.in
```kconfig
config BR2_PACKAGE_LIBFPRINT
	bool "libfprint"
	depends on BR2_TOOLCHAIN_HAS_THREADS
	depends on BR2_USE_MMU
	select BR2_PACKAGE_LIBUSB
	select BR2_PACKAGE_LIBGLIB2
	select BR2_PACKAGE_PIXMAN
	help
	  libfprint is an open source software library designed to make
	  it easy to add support for consumer fingerprint readers to
	  your software.

	  https://fprint.freedesktop.org/

comment "libfprint needs a toolchain w/ threads"
	depends on !BR2_TOOLCHAIN_HAS_THREADS
```

## package/pocketsphinx/Config.in
```kconfig
config BR2_PACKAGE_POCKETSPHINX
	bool "pocketsphinx"
	depends on BR2_TOOLCHAIN_HAS_THREADS
	select BR2_PACKAGE_SPHINXBASE
	help
	  PocketSphinx is a lightweight speech recognition engine,
	  specifically tuned for handheld and mobile devices, though
	  it works equally well on the desktop.

	  https://github.com/cmusphinx/pocketsphinx

comment "pocketsphinx needs a toolchain w/ threads"
	depends on !BR2_TOOLCHAIN_HAS_THREADS
```

## package/shredos-vault/Config.in
```kconfig
config BR2_PACKAGE_SHREDOS_VAULT
	bool "shredos-vault"
	select BR2_PACKAGE_NCURSES
	select BR2_PACKAGE_CRYPTSETUP
	select BR2_PACKAGE_LIBCONFIG
	select BR2_PACKAGE_NWIPE
	help
	  ShredOS Vault -- Pre-boot authentication gate with dead man's switch.

	  Provides a TUI-based authentication screen that runs before the OS
	  boots. If authentication fails N times, the dead man's switch
	  encrypts and wipes the target drive.

	  Includes an installer wizard to deploy Vault onto a host OS
	  (Linux, macOS, or Windows) from the ShredOS USB.

if BR2_PACKAGE_SHREDOS_VAULT

config BR2_PACKAGE_SHREDOS_VAULT_FINGERPRINT
	bool "Fingerprint authentication"
	select BR2_PACKAGE_LIBFPRINT
	help
	  Enable USB fingerprint reader support via libfprint.

config BR2_PACKAGE_SHREDOS_VAULT_VOICE
	bool "Voice passphrase authentication"
	select BR2_PACKAGE_PORTAUDIO
	help
	  Enable voice passphrase recognition via PocketSphinx and PortAudio.

config BR2_PACKAGE_SHREDOS_VAULT_NTFS
	bool "NTFS support (for Windows installation)"
	select BR2_PACKAGE_NTFS_3G
	help
	  Enable NTFS read/write support for installing ShredOS Vault
	  onto Windows partitions.

endif
```
